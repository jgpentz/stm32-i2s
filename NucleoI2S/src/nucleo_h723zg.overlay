&sdmmc1 {
    status = "okay";
    pinctrl-0 = <
        &sdmmc1_d0_pc8
        &sdmmc1_d1_pc9
        &sdmmc1_d2_pc10
        &sdmmc1_d3_pc11
        &sdmmc1_ck_pc12
        &sdmmc1_cmd_pd2>;
    clk-div = <2>;
    bus-width = <1>;
    pinctrl-names = "default";
    clocks = <&rcc STM32_CLOCK_BUS_AHB3 0x00010000>,
        <&rcc STM32_SRC_HSI48 SDMMC_SEL(0)>;
};

&i2c1 {
    pinctrl-0 = <&i2c1_scl_pb8 &i2c1_sda_pb9>;
    pinctrl-names = "default";
    status = "okay";
    clock-frequency = <I2C_BITRATE_FAST>;
};
