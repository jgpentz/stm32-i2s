## build/Kconfig/Kconfig.modules
```kconfig
menu "acpica (/Users/jamespentz/Code/zephyr/nucleo_i2s/modules/lib/acpica)"
osource "$(ZEPHYR_ACPICA_KCONFIG)"
config ZEPHYR_ACPICA_MODULE
	bool
	default y
endmenu
menu "cmsis (/Users/jamespentz/Code/zephyr/nucleo_i2s/modules/hal/cmsis)"
osource "$(ZEPHYR_CMSIS_KCONFIG)"
config ZEPHYR_CMSIS_MODULE
	bool
	default y
endmenu
menu "cmsis-dsp (/Users/jamespentz/Code/zephyr/nucleo_i2s/modules/lib/cmsis-dsp)"
osource "$(ZEPHYR_CMSIS_DSP_KCONFIG)"
config ZEPHYR_CMSIS_DSP_MODULE
	bool
	default y
endmenu
menu "cmsis-nn (/Users/jamespentz/Code/zephyr/nucleo_i2s/modules/lib/cmsis-nn)"
osource "$(ZEPHYR_CMSIS_NN_KCONFIG)"
config ZEPHYR_CMSIS_NN_MODULE
	bool
	default y
endmenu
menu "fatfs (/Users/jamespentz/Code/zephyr/nucleo_i2s/modules/fs/fatfs)"
osource "$(ZEPHYR_FATFS_KCONFIG)"
config ZEPHYR_FATFS_MODULE
	bool
	default y
endmenu
config ZEPHYR_ADI_MODULE
	bool
	default y
config ZEPHYR_ALTERA_MODULE
	bool
	default y
menu "hal_ambiq (/Users/jamespentz/Code/zephyr/nucleo_i2s/modules/hal/ambiq)"
osource "$(ZEPHYR_HAL_AMBIQ_KCONFIG)"
config ZEPHYR_HAL_AMBIQ_MODULE
	bool
	default y
endmenu
config ZEPHYR_ATMEL_MODULE
	bool
	default y
menu "hal_espressif (/Users/jamespentz/Code/zephyr/nucleo_i2s/modules/hal/espressif)"
osource "/Users/jamespentz/Code/zephyr/nucleo_i2s/modules/hal/espressif/zephyr/Kconfig"
config ZEPHYR_HAL_ESPRESSIF_MODULE
	bool
	default y

config ZEPHYR_HAL_ESPRESSIF_MODULE_BLOBS
	bool
endmenu
menu "hal_ethos_u (/Users/jamespentz/Code/zephyr/nucleo_i2s/modules/hal/ethos_u)"
osource "$(ZEPHYR_HAL_ETHOS_U_KCONFIG)"
config ZEPHYR_HAL_ETHOS_U_MODULE
	bool
	default y
endmenu
menu "hal_gigadevice (/Users/jamespentz/Code/zephyr/nucleo_i2s/modules/hal/gigadevice)"
osource "$(ZEPHYR_HAL_GIGADEVICE_KCONFIG)"
config ZEPHYR_HAL_GIGADEVICE_MODULE
	bool
	default y
endmenu
menu "hal_infineon (/Users/jamespentz/Code/zephyr/nucleo_i2s/modules/hal/infineon)"
osource "$(ZEPHYR_HAL_INFINEON_KCONFIG)"
config ZEPHYR_HAL_INFINEON_MODULE
	bool
	default y

config ZEPHYR_HAL_INFINEON_MODULE_BLOBS
	bool
endmenu
menu "hal_intel (/Users/jamespentz/Code/zephyr/nucleo_i2s/modules/hal/intel)"
osource "/Users/jamespentz/Code/zephyr/nucleo_i2s/modules/hal/intel/zephyr/Kconfig"
config ZEPHYR_HAL_INTEL_MODULE
	bool
	default y
endmenu
config ZEPHYR_MICROCHIP_MODULE
	bool
	default y
menu "hal_nordic (/Users/jamespentz/Code/zephyr/nucleo_i2s/modules/hal/nordic)"
osource "$(ZEPHYR_HAL_NORDIC_KCONFIG)"
config ZEPHYR_HAL_NORDIC_MODULE
	bool
	default y

config ZEPHYR_HAL_NORDIC_MODULE_BLOBS
	bool
endmenu
config ZEPHYR_NUVOTON_MODULE
	bool
	default y
menu "hal_nxp (/Users/jamespentz/Code/zephyr/nucleo_i2s/modules/hal/nxp)"
osource "$(ZEPHYR_HAL_NXP_KCONFIG)"
config ZEPHYR_HAL_NXP_MODULE
	bool
	default y

config ZEPHYR_HAL_NXP_MODULE_BLOBS
	bool
endmenu
config ZEPHYR_OPENISA_MODULE
	bool
	default y
config ZEPHYR_QUICKLOGIC_MODULE
	bool
	default y
config ZEPHYR_HAL_RENESAS_MODULE
	bool
	default y

config ZEPHYR_HAL_RENESAS_MODULE_BLOBS
	bool
menu "hal_rpi_pico (/Users/jamespentz/Code/zephyr/nucleo_i2s/modules/hal/rpi_pico)"
osource "$(ZEPHYR_HAL_RPI_PICO_KCONFIG)"
config ZEPHYR_HAL_RPI_PICO_MODULE
	bool
	default y
endmenu
menu "hal_silabs (/Users/jamespentz/Code/zephyr/nucleo_i2s/modules/hal/silabs)"
osource "/Users/jamespentz/Code/zephyr/nucleo_i2s/modules/hal/silabs/zephyr/Kconfig"
config ZEPHYR_HAL_SILABS_MODULE
	bool
	default y

config ZEPHYR_HAL_SILABS_MODULE_BLOBS
	bool
endmenu
menu "hal_st (/Users/jamespentz/Code/zephyr/nucleo_i2s/modules/hal/st)"
osource "$(ZEPHYR_HAL_ST_KCONFIG)"
config ZEPHYR_HAL_ST_MODULE
	bool
	default y
endmenu
config ZEPHYR_HAL_STM32_MODULE
	bool
	default y

config ZEPHYR_HAL_STM32_MODULE_BLOBS
	bool
menu "hal_telink (/Users/jamespentz/Code/zephyr/nucleo_i2s/modules/hal/telink)"
osource "/Users/jamespentz/Code/zephyr/nucleo_i2s/modules/hal/telink/Kconfig"
config ZEPHYR_HAL_TELINK_MODULE
	bool
	default y
endmenu
config ZEPHYR_TI_MODULE
	bool
	default y
config ZEPHYR_HAL_WURTHELEKTRONIK_MODULE
	bool
	default y
config ZEPHYR_XTENSA_MODULE
	bool
	default y
menu "hostap (/Users/jamespentz/Code/zephyr/nucleo_i2s/modules/lib/hostap)"
osource "$(ZEPHYR_HOSTAP_KCONFIG)"
config ZEPHYR_HOSTAP_MODULE
	bool
	default y
endmenu
config ZEPHYR_LIBMETAL_MODULE
	bool
	default y
menu "liblc3 (/Users/jamespentz/Code/zephyr/nucleo_i2s/modules/lib/liblc3)"
osource "$(ZEPHYR_LIBLC3_KCONFIG)"
config ZEPHYR_LIBLC3_MODULE
	bool
	default y
endmenu
menu "littlefs (/Users/jamespentz/Code/zephyr/nucleo_i2s/modules/fs/littlefs)"
osource "$(ZEPHYR_LITTLEFS_KCONFIG)"
config ZEPHYR_LITTLEFS_MODULE
	bool
	default y
endmenu
menu "loramac-node (/Users/jamespentz/Code/zephyr/nucleo_i2s/modules/lib/loramac-node)"
osource "$(ZEPHYR_LORAMAC_NODE_KCONFIG)"
config ZEPHYR_LORAMAC_NODE_MODULE
	bool
	default y
endmenu
menu "lvgl (/Users/jamespentz/Code/zephyr/nucleo_i2s/modules/lib/gui/lvgl)"
osource "/Users/jamespentz/Code/zephyr/nucleo_i2s/modules/lib/gui/lvgl/Kconfig"
config ZEPHYR_LVGL_MODULE
	bool
	default y
endmenu
menu "mbedtls (/Users/jamespentz/Code/zephyr/nucleo_i2s/modules/crypto/mbedtls)"
osource "$(ZEPHYR_MBEDTLS_KCONFIG)"
config ZEPHYR_MBEDTLS_MODULE
	bool
	default y
endmenu
config ZEPHYR_MCUBOOT_MODULE
	bool
	default y
config ZEPHYR_MIPI_SYS_T_MODULE
	bool
	default y
config ZEPHYR_NRF_HW_MODELS_MODULE
	bool
	default y
config ZEPHYR_OPEN_AMP_MODULE
	bool
	default y
menu "openthread (/Users/jamespentz/Code/zephyr/nucleo_i2s/modules/lib/openthread)"
osource "$(ZEPHYR_OPENTHREAD_KCONFIG)"
config ZEPHYR_OPENTHREAD_MODULE
	bool
	default y
endmenu
menu "percepio (/Users/jamespentz/Code/zephyr/nucleo_i2s/modules/debug/percepio)"
osource "/Users/jamespentz/Code/zephyr/nucleo_i2s/modules/debug/percepio/zephyr/Kconfig"
config ZEPHYR_PERCEPIO_MODULE
	bool
	default y
endmenu
menu "picolibc (/Users/jamespentz/Code/zephyr/nucleo_i2s/modules/lib/picolibc)"
osource "/Users/jamespentz/Code/zephyr/nucleo_i2s/modules/lib/picolibc/zephyr/Kconfig"
config ZEPHYR_PICOLIBC_MODULE
	bool
	default y
endmenu
menu "segger (/Users/jamespentz/Code/zephyr/nucleo_i2s/modules/debug/segger)"
osource "$(ZEPHYR_SEGGER_KCONFIG)"
config ZEPHYR_SEGGER_MODULE
	bool
	default y
endmenu
config ZEPHYR_TINYCRYPT_MODULE
	bool
	default y
menu "trusted-firmware-m (/Users/jamespentz/Code/zephyr/nucleo_i2s/modules/tee/tf-m/trusted-firmware-m)"
osource "$(ZEPHYR_TRUSTED_FIRMWARE_M_KCONFIG)"
config ZEPHYR_TRUSTED_FIRMWARE_M_MODULE
	bool
	default y
endmenu
menu "trusted-firmware-a (/Users/jamespentz/Code/zephyr/nucleo_i2s/modules/tee/tf-a/trusted-firmware-a)"
osource "$(ZEPHYR_TRUSTED_FIRMWARE_A_KCONFIG)"
config ZEPHYR_TRUSTED_FIRMWARE_A_MODULE
	bool
	default y
endmenu
menu "uoscore-uedhoc (/Users/jamespentz/Code/zephyr/nucleo_i2s/modules/lib/uoscore-uedhoc)"
osource "$(ZEPHYR_UOSCORE_UEDHOC_KCONFIG)"
config ZEPHYR_UOSCORE_UEDHOC_MODULE
	bool
	default y
endmenu
menu "zcbor (/Users/jamespentz/Code/zephyr/nucleo_i2s/modules/lib/zcbor)"
osource "$(ZEPHYR_ZCBOR_KCONFIG)"
config ZEPHYR_ZCBOR_MODULE
	bool
	default y
endmenu
```

## build/Kconfig/arch/Kconfig
```kconfig
# Load arch Kconfig descriptions.
osource "/Users/jamespentz/code/zephyr/nucleo_i2s/zephyr/arch/x86/Kconfig"
osource "/Users/jamespentz/code/zephyr/nucleo_i2s/zephyr/arch/xtensa/Kconfig"
osource "/Users/jamespentz/code/zephyr/nucleo_i2s/zephyr/arch/sparc/Kconfig"
osource "/Users/jamespentz/code/zephyr/nucleo_i2s/zephyr/arch/riscv/Kconfig"
osource "/Users/jamespentz/code/zephyr/nucleo_i2s/zephyr/arch/posix/Kconfig"
osource "/Users/jamespentz/code/zephyr/nucleo_i2s/zephyr/arch/nios2/Kconfig"
osource "/Users/jamespentz/code/zephyr/nucleo_i2s/zephyr/arch/mips/Kconfig"
osource "/Users/jamespentz/code/zephyr/nucleo_i2s/zephyr/arch/arm64/Kconfig"
osource "/Users/jamespentz/code/zephyr/nucleo_i2s/zephyr/arch/arm/Kconfig"
osource "/Users/jamespentz/code/zephyr/nucleo_i2s/zephyr/arch/arc/Kconfig"
```

## build/Kconfig/soc/Kconfig
```kconfig
# Load Zephyr SoC Kconfig descriptions.
osource "/Users/jamespentz/code/zephyr/nucleo_i2s/zephyr/soc/xlnx/zynqmp/Kconfig"
osource "/Users/jamespentz/code/zephyr/nucleo_i2s/zephyr/soc/xlnx/zynq7000/Kconfig"
osource "/Users/jamespentz/code/zephyr/nucleo_i2s/zephyr/soc/xen/Kconfig"
osource "/Users/jamespentz/code/zephyr/nucleo_i2s/zephyr/soc/ti/simplelink/Kconfig"
osource "/Users/jamespentz/code/zephyr/nucleo_i2s/zephyr/soc/ti/lm3s6965/Kconfig"
osource "/Users/jamespentz/code/zephyr/nucleo_i2s/zephyr/soc/ti/k3/Kconfig"
osource "/Users/jamespentz/code/zephyr/nucleo_i2s/zephyr/soc/telink/tlsr/Kconfig"
osource "/Users/jamespentz/code/zephyr/nucleo_i2s/zephyr/soc/starfive/jh71xx/Kconfig"
osource "/Users/jamespentz/code/zephyr/nucleo_i2s/zephyr/soc/st/stm32/Kconfig"
osource "/Users/jamespentz/code/zephyr/nucleo_i2s/zephyr/soc/snps/qemu_arc/Kconfig"
osource "/Users/jamespentz/code/zephyr/nucleo_i2s/zephyr/soc/snps/nsim/arc_v/Kconfig"
osource "/Users/jamespentz/code/zephyr/nucleo_i2s/zephyr/soc/snps/nsim/arc_classic/Kconfig"
osource "/Users/jamespentz/code/zephyr/nucleo_i2s/zephyr/soc/snps/hsdk4xd/Kconfig"
osource "/Users/jamespentz/code/zephyr/nucleo_i2s/zephyr/soc/snps/hsdk/Kconfig"
osource "/Users/jamespentz/code/zephyr/nucleo_i2s/zephyr/soc/snps/emsk/Kconfig"
osource "/Users/jamespentz/code/zephyr/nucleo_i2s/zephyr/soc/snps/emsdp/Kconfig"
osource "/Users/jamespentz/code/zephyr/nucleo_i2s/zephyr/soc/snps/arc_iot/Kconfig"
osource "/Users/jamespentz/code/zephyr/nucleo_i2s/zephyr/soc/silabs/Kconfig"
osource "/Users/jamespentz/code/zephyr/nucleo_i2s/zephyr/soc/sifive/sifive_freedom/Kconfig"
osource "/Users/jamespentz/code/zephyr/nucleo_i2s/zephyr/soc/sensry/Kconfig"
osource "/Users/jamespentz/code/zephyr/nucleo_i2s/zephyr/soc/rockchip/Kconfig"
osource "/Users/jamespentz/code/zephyr/nucleo_i2s/zephyr/soc/renode/riscv_virtual/Kconfig"
osource "/Users/jamespentz/code/zephyr/nucleo_i2s/zephyr/soc/renode/cortex_r8_virtual/Kconfig"
osource "/Users/jamespentz/code/zephyr/nucleo_i2s/zephyr/soc/renesas/smartbond/Kconfig"
osource "/Users/jamespentz/code/zephyr/nucleo_i2s/zephyr/soc/renesas/rzt2m/Kconfig"
osource "/Users/jamespentz/code/zephyr/nucleo_i2s/zephyr/soc/renesas/rcar/Kconfig"
osource "/Users/jamespentz/code/zephyr/nucleo_i2s/zephyr/soc/renesas/ra/Kconfig"
osource "/Users/jamespentz/code/zephyr/nucleo_i2s/zephyr/soc/raspberrypi/Kconfig"
osource "/Users/jamespentz/code/zephyr/nucleo_i2s/zephyr/soc/quicklogic/eos_s3/Kconfig"
osource "/Users/jamespentz/code/zephyr/nucleo_i2s/zephyr/soc/qemu/virt_riscv/Kconfig"
osource "/Users/jamespentz/code/zephyr/nucleo_i2s/zephyr/soc/qemu/malta/Kconfig"
osource "/Users/jamespentz/code/zephyr/nucleo_i2s/zephyr/soc/openisa/rv32m1/Kconfig"
osource "/Users/jamespentz/code/zephyr/nucleo_i2s/zephyr/soc/nxp/s32/Kconfig"
osource "/Users/jamespentz/code/zephyr/nucleo_i2s/zephyr/soc/nxp/rw/Kconfig"
osource "/Users/jamespentz/code/zephyr/nucleo_i2s/zephyr/soc/nxp/mcx/Kconfig"
osource "/Users/jamespentz/code/zephyr/nucleo_i2s/zephyr/soc/nxp/lpc/Kconfig"
osource "/Users/jamespentz/code/zephyr/nucleo_i2s/zephyr/soc/nxp/layerscape/Kconfig"
osource "/Users/jamespentz/code/zephyr/nucleo_i2s/zephyr/soc/nxp/kinetis/Kconfig"
osource "/Users/jamespentz/code/zephyr/nucleo_i2s/zephyr/soc/nxp/imxrt/Kconfig"
osource "/Users/jamespentz/code/zephyr/nucleo_i2s/zephyr/soc/nxp/imx/Kconfig"
osource "/Users/jamespentz/code/zephyr/nucleo_i2s/zephyr/soc/nuvoton/numicro/Kconfig"
osource "/Users/jamespentz/code/zephyr/nucleo_i2s/zephyr/soc/nuvoton/numaker/Kconfig"
osource "/Users/jamespentz/code/zephyr/nucleo_i2s/zephyr/soc/nuvoton/npcx/Kconfig"
osource "/Users/jamespentz/code/zephyr/nucleo_i2s/zephyr/soc/nuvoton/npcm/Kconfig"
osource "/Users/jamespentz/code/zephyr/nucleo_i2s/zephyr/soc/nordic/Kconfig"
osource "/Users/jamespentz/code/zephyr/nucleo_i2s/zephyr/soc/neorv32/Kconfig"
osource "/Users/jamespentz/code/zephyr/nucleo_i2s/zephyr/soc/native/inf_clock/Kconfig"
osource "/Users/jamespentz/code/zephyr/nucleo_i2s/zephyr/soc/microchip/miv/Kconfig"
osource "/Users/jamespentz/code/zephyr/nucleo_i2s/zephyr/soc/microchip/mec/Kconfig"
osource "/Users/jamespentz/code/zephyr/nucleo_i2s/zephyr/soc/mediatek/mtk_adsp/Kconfig"
osource "/Users/jamespentz/code/zephyr/nucleo_i2s/zephyr/soc/lowrisc/opentitan/Kconfig"
osource "/Users/jamespentz/code/zephyr/nucleo_i2s/zephyr/soc/litex/litex_vexriscv/Kconfig"
osource "/Users/jamespentz/code/zephyr/nucleo_i2s/zephyr/soc/ite/ec/Kconfig"
osource "/Users/jamespentz/code/zephyr/nucleo_i2s/zephyr/soc/intel/raptor_lake/Kconfig"
osource "/Users/jamespentz/code/zephyr/nucleo_i2s/zephyr/soc/intel/lakemont/Kconfig"
osource "/Users/jamespentz/code/zephyr/nucleo_i2s/zephyr/soc/intel/intel_socfpga_std/Kconfig"
osource "/Users/jamespentz/code/zephyr/nucleo_i2s/zephyr/soc/intel/intel_socfpga/Kconfig"
osource "/Users/jamespentz/code/zephyr/nucleo_i2s/zephyr/soc/intel/intel_niosv/Kconfig"
osource "/Users/jamespentz/code/zephyr/nucleo_i2s/zephyr/soc/intel/intel_ish/Kconfig"
osource "/Users/jamespentz/code/zephyr/nucleo_i2s/zephyr/soc/intel/intel_adsp/Kconfig"
osource "/Users/jamespentz/code/zephyr/nucleo_i2s/zephyr/soc/intel/elkhart_lake/Kconfig"
osource "/Users/jamespentz/code/zephyr/nucleo_i2s/zephyr/soc/intel/atom/Kconfig"
osource "/Users/jamespentz/code/zephyr/nucleo_i2s/zephyr/soc/intel/apollo_lake/Kconfig"
osource "/Users/jamespentz/code/zephyr/nucleo_i2s/zephyr/soc/intel/alder_lake/Kconfig"
osource "/Users/jamespentz/code/zephyr/nucleo_i2s/zephyr/soc/infineon/cat3/Kconfig"
osource "/Users/jamespentz/code/zephyr/nucleo_i2s/zephyr/soc/infineon/cat1b/Kconfig"
osource "/Users/jamespentz/code/zephyr/nucleo_i2s/zephyr/soc/infineon/cat1a/Kconfig"
osource "/Users/jamespentz/code/zephyr/nucleo_i2s/zephyr/soc/gd/gd32/Kconfig"
osource "/Users/jamespentz/code/zephyr/nucleo_i2s/zephyr/soc/gaisler/leon3/Kconfig"
osource "/Users/jamespentz/code/zephyr/nucleo_i2s/zephyr/soc/gaisler/gr716a/Kconfig"
osource "/Users/jamespentz/code/zephyr/nucleo_i2s/zephyr/soc/espressif/Kconfig"
osource "/Users/jamespentz/code/zephyr/nucleo_i2s/zephyr/soc/ene/kb1200/Kconfig"
osource "/Users/jamespentz/code/zephyr/nucleo_i2s/zephyr/soc/efinix/sapphire/Kconfig"
osource "/Users/jamespentz/code/zephyr/nucleo_i2s/zephyr/soc/cdns/xtensa_sample_controller/Kconfig"
osource "/Users/jamespentz/code/zephyr/nucleo_i2s/zephyr/soc/cdns/sample_controller32/Kconfig"
osource "/Users/jamespentz/code/zephyr/nucleo_i2s/zephyr/soc/cdns/dc233c/Kconfig"
osource "/Users/jamespentz/code/zephyr/nucleo_i2s/zephyr/soc/brcm/bcmvk/Kconfig"
osource "/Users/jamespentz/code/zephyr/nucleo_i2s/zephyr/soc/brcm/bcm2712/Kconfig"
osource "/Users/jamespentz/code/zephyr/nucleo_i2s/zephyr/soc/brcm/bcm2711/Kconfig"
osource "/Users/jamespentz/code/zephyr/nucleo_i2s/zephyr/soc/atmel/sam0/Kconfig"
osource "/Users/jamespentz/code/zephyr/nucleo_i2s/zephyr/soc/atmel/sam/Kconfig"
osource "/Users/jamespentz/code/zephyr/nucleo_i2s/zephyr/soc/aspeed/Kconfig"
osource "/Users/jamespentz/code/zephyr/nucleo_i2s/zephyr/soc/arm/Kconfig"
osource "/Users/jamespentz/code/zephyr/nucleo_i2s/zephyr/soc/arm/beetle/Kconfig"
osource "/Users/jamespentz/code/zephyr/nucleo_i2s/zephyr/soc/andestech/Kconfig"
osource "/Users/jamespentz/code/zephyr/nucleo_i2s/zephyr/soc/ambiq/Kconfig"
osource "/Users/jamespentz/code/zephyr/nucleo_i2s/zephyr/soc/altr/zephyr_nios2f/Kconfig"
osource "/Users/jamespentz/code/zephyr/nucleo_i2s/zephyr/soc/altr/qemu_nios2/Kconfig"
osource "/Users/jamespentz/code/zephyr/nucleo_i2s/zephyr/soc/adi/max32/Kconfig"
```
