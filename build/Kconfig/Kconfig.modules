## build/Kconfig/soc/Kconfig.soc
```kconfig
# Load SoC Kconfig descriptions.
osource "/Users/jamespentz/code/zephyr/nucleo_i2s/zephyr/soc/xlnx/zynqmp/Kconfig.soc"
osource "/Users/jamespentz/code/zephyr/nucleo_i2s/zephyr/soc/xlnx/zynq7000/Kconfig.soc"
osource "/Users/jamespentz/code/zephyr/nucleo_i2s/zephyr/soc/xen/Kconfig.soc"
osource "/Users/jamespentz/code/zephyr/nucleo_i2s/zephyr/soc/ti/simplelink/Kconfig.soc"
osource "/Users/jamespentz/code/zephyr/nucleo_i2s/zephyr/soc/ti/lm3s6965/Kconfig.soc"
osource "/Users/jamespentz/code/zephyr/nucleo_i2s/zephyr/soc/ti/k3/Kconfig.soc"
osource "/Users/jamespentz/code/zephyr/nucleo_i2s/zephyr/soc/telink/tlsr/Kconfig.soc"
osource "/Users/jamespentz/code/zephyr/nucleo_i2s/zephyr/soc/starfive/jh71xx/Kconfig.soc"
osource "/Users/jamespentz/code/zephyr/nucleo_i2s/zephyr/soc/st/stm32/Kconfig.soc"
osource "/Users/jamespentz/code/zephyr/nucleo_i2s/zephyr/soc/snps/qemu_arc/Kconfig.soc"
osource "/Users/jamespentz/code/zephyr/nucleo_i2s/zephyr/soc/snps/nsim/arc_v/Kconfig.soc"
osource "/Users/jamespentz/code/zephyr/nucleo_i2s/zephyr/soc/snps/nsim/arc_classic/Kconfig.soc"
osource "/Users/jamespentz/code/zephyr/nucleo_i2s/zephyr/soc/snps/hsdk4xd/Kconfig.soc"
osource "/Users/jamespentz/code/zephyr/nucleo_i2s/zephyr/soc/snps/hsdk/Kconfig.soc"
osource "/Users/jamespentz/code/zephyr/nucleo_i2s/zephyr/soc/snps/emsk/Kconfig.soc"
osource "/Users/jamespentz/code/zephyr/nucleo_i2s/zephyr/soc/snps/emsdp/Kconfig.soc"
osource "/Users/jamespentz/code/zephyr/nucleo_i2s/zephyr/soc/snps/arc_iot/Kconfig.soc"
osource "/Users/jamespentz/code/zephyr/nucleo_i2s/zephyr/soc/silabs/Kconfig.soc"
osource "/Users/jamespentz/code/zephyr/nucleo_i2s/zephyr/soc/sifive/sifive_freedom/Kconfig.soc"
osource "/Users/jamespentz/code/zephyr/nucleo_i2s/zephyr/soc/sensry/Kconfig.soc"
osource "/Users/jamespentz/code/zephyr/nucleo_i2s/zephyr/soc/rockchip/Kconfig.soc"
osource "/Users/jamespentz/code/zephyr/nucleo_i2s/zephyr/soc/renode/riscv_virtual/Kconfig.soc"
osource "/Users/jamespentz/code/zephyr/nucleo_i2s/zephyr/soc/renode/cortex_r8_virtual/Kconfig.soc"
osource "/Users/jamespentz/code/zephyr/nucleo_i2s/zephyr/soc/renesas/smartbond/Kconfig.soc"
osource "/Users/jamespentz/code/zephyr/nucleo_i2s/zephyr/soc/renesas/rzt2m/Kconfig.soc"
osource "/Users/jamespentz/code/zephyr/nucleo_i2s/zephyr/soc/renesas/rcar/Kconfig.soc"
osource "/Users/jamespentz/code/zephyr/nucleo_i2s/zephyr/soc/renesas/ra/Kconfig.soc"
osource "/Users/jamespentz/code/zephyr/nucleo_i2s/zephyr/soc/raspberrypi/Kconfig.soc"
osource "/Users/jamespentz/code/zephyr/nucleo_i2s/zephyr/soc/quicklogic/eos_s3/Kconfig.soc"
osource "/Users/jamespentz/code/zephyr/nucleo_i2s/zephyr/soc/qemu/virt_riscv/Kconfig.soc"
osource "/Users/jamespentz/code/zephyr/nucleo_i2s/zephyr/soc/qemu/malta/Kconfig.soc"
osource "/Users/jamespentz/code/zephyr/nucleo_i2s/zephyr/soc/openisa/rv32m1/Kconfig.soc"
osource "/Users/jamespentz/code/zephyr/nucleo_i2s/zephyr/soc/nxp/s32/Kconfig.soc"
osource "/Users/jamespentz/code/zephyr/nucleo_i2s/zephyr/soc/nxp/rw/Kconfig.soc"
osource "/Users/jamespentz/code/zephyr/nucleo_i2s/zephyr/soc/nxp/mcx/Kconfig.soc"
osource "/Users/jamespentz/code/zephyr/nucleo_i2s/zephyr/soc/nxp/lpc/Kconfig.soc"
osource "/Users/jamespentz/code/zephyr/nucleo_i2s/zephyr/soc/nxp/layerscape/Kconfig.soc"
osource "/Users/jamespentz/code/zephyr/nucleo_i2s/zephyr/soc/nxp/kinetis/Kconfig.soc"
osource "/Users/jamespentz/code/zephyr/nucleo_i2s/zephyr/soc/nxp/imxrt/Kconfig.soc"
osource "/Users/jamespentz/code/zephyr/nucleo_i2s/zephyr/soc/nxp/imx/Kconfig.soc"
osource "/Users/jamespentz/code/zephyr/nucleo_i2s/zephyr/soc/nuvoton/numicro/Kconfig.soc"
osource "/Users/jamespentz/code/zephyr/nucleo_i2s/zephyr/soc/nuvoton/numaker/Kconfig.soc"
osource "/Users/jamespentz/code/zephyr/nucleo_i2s/zephyr/soc/nuvoton/npcx/Kconfig.soc"
osource "/Users/jamespentz/code/zephyr/nucleo_i2s/zephyr/soc/nuvoton/npcm/Kconfig.soc"
osource "/Users/jamespentz/code/zephyr/nucleo_i2s/zephyr/soc/nordic/Kconfig.soc"
osource "/Users/jamespentz/code/zephyr/nucleo_i2s/zephyr/soc/neorv32/Kconfig.soc"
osource "/Users/jamespentz/code/zephyr/nucleo_i2s/zephyr/soc/native/inf_clock/Kconfig.soc"
osource "/Users/jamespentz/code/zephyr/nucleo_i2s/zephyr/soc/microchip/miv/Kconfig.soc"
osource "/Users/jamespentz/code/zephyr/nucleo_i2s/zephyr/soc/microchip/mec/Kconfig.soc"
osource "/Users/jamespentz/code/zephyr/nucleo_i2s/zephyr/soc/mediatek/mtk_adsp/Kconfig.soc"
osource "/Users/jamespentz/code/zephyr/nucleo_i2s/zephyr/soc/lowrisc/opentitan/Kconfig.soc"
osource "/Users/jamespentz/code/zephyr/nucleo_i2s/zephyr/soc/litex/litex_vexriscv/Kconfig.soc"
osource "/Users/jamespentz/code/zephyr/nucleo_i2s/zephyr/soc/ite/ec/Kconfig.soc"
osource "/Users/jamespentz/code/zephyr/nucleo_i2s/zephyr/soc/intel/raptor_lake/Kconfig.soc"
osource "/Users/jamespentz/code/zephyr/nucleo_i2s/zephyr/soc/intel/lakemont/Kconfig.soc"
osource "/Users/jamespentz/code/zephyr/nucleo_i2s/zephyr/soc/intel/intel_socfpga_std/Kconfig.soc"
osource "/Users/jamespentz/code/zephyr/nucleo_i2s/zephyr/soc/intel/intel_socfpga/Kconfig.soc"
osource "/Users/jamespentz/code/zephyr/nucleo_i2s/zephyr/soc/intel/intel_niosv/Kconfig.soc"
osource "/Users/jamespentz/code/zephyr/nucleo_i2s/zephyr/soc/intel/intel_ish/Kconfig.soc"
osource "/Users/jamespentz/code/zephyr/nucleo_i2s/zephyr/soc/intel/intel_adsp/Kconfig.soc"
osource "/Users/jamespentz/code/zephyr/nucleo_i2s/zephyr/soc/intel/elkhart_lake/Kconfig.soc"
osource "/Users/jamespentz/code/zephyr/nucleo_i2s/zephyr/soc/intel/atom/Kconfig.soc"
osource "/Users/jamespentz/code/zephyr/nucleo_i2s/zephyr/soc/intel/apollo_lake/Kconfig.soc"
osource "/Users/jamespentz/code/zephyr/nucleo_i2s/zephyr/soc/intel/alder_lake/Kconfig.soc"
osource "/Users/jamespentz/code/zephyr/nucleo_i2s/zephyr/soc/infineon/cat3/Kconfig.soc"
osource "/Users/jamespentz/code/zephyr/nucleo_i2s/zephyr/soc/infineon/cat1b/Kconfig.soc"
osource "/Users/jamespentz/code/zephyr/nucleo_i2s/zephyr/soc/infineon/cat1a/Kconfig.soc"
osource "/Users/jamespentz/code/zephyr/nucleo_i2s/zephyr/soc/gd/gd32/Kconfig.soc"
osource "/Users/jamespentz/code/zephyr/nucleo_i2s/zephyr/soc/gaisler/leon3/Kconfig.soc"
osource "/Users/jamespentz/code/zephyr/nucleo_i2s/zephyr/soc/gaisler/gr716a/Kconfig.soc"
osource "/Users/jamespentz/code/zephyr/nucleo_i2s/zephyr/soc/espressif/Kconfig.soc"
osource "/Users/jamespentz/code/zephyr/nucleo_i2s/zephyr/soc/ene/kb1200/Kconfig.soc"
osource "/Users/jamespentz/code/zephyr/nucleo_i2s/zephyr/soc/efinix/sapphire/Kconfig.soc"
osource "/Users/jamespentz/code/zephyr/nucleo_i2s/zephyr/soc/cdns/xtensa_sample_controller/Kconfig.soc"
osource "/Users/jamespentz/code/zephyr/nucleo_i2s/zephyr/soc/cdns/sample_controller32/Kconfig.soc"
osource "/Users/jamespentz/code/zephyr/nucleo_i2s/zephyr/soc/cdns/dc233c/Kconfig.soc"
osource "/Users/jamespentz/code/zephyr/nucleo_i2s/zephyr/soc/brcm/bcmvk/Kconfig.soc"
osource "/Users/jamespentz/code/zephyr/nucleo_i2s/zephyr/soc/brcm/bcm2712/Kconfig.soc"
osource "/Users/jamespentz/code/zephyr/nucleo_i2s/zephyr/soc/brcm/bcm2711/Kconfig.soc"
osource "/Users/jamespentz/code/zephyr/nucleo_i2s/zephyr/soc/atmel/sam0/Kconfig.soc"
osource "/Users/jamespentz/code/zephyr/nucleo_i2s/zephyr/soc/atmel/sam/Kconfig.soc"
osource "/Users/jamespentz/code/zephyr/nucleo_i2s/zephyr/soc/aspeed/Kconfig.soc"
osource "/Users/jamespentz/code/zephyr/nucleo_i2s/zephyr/soc/arm/Kconfig.soc"
osource "/Users/jamespentz/code/zephyr/nucleo_i2s/zephyr/soc/arm/beetle/Kconfig.soc"
osource "/Users/jamespentz/code/zephyr/nucleo_i2s/zephyr/soc/andestech/Kconfig.soc"
osource "/Users/jamespentz/code/zephyr/nucleo_i2s/zephyr/soc/ambiq/Kconfig.soc"
osource "/Users/jamespentz/code/zephyr/nucleo_i2s/zephyr/soc/altr/zephyr_nios2f/Kconfig.soc"
osource "/Users/jamespentz/code/zephyr/nucleo_i2s/zephyr/soc/altr/qemu_nios2/Kconfig.soc"
osource "/Users/jamespentz/code/zephyr/nucleo_i2s/zephyr/soc/adi/max32/Kconfig.soc"
```
